## main/Kconfig.projbuild
```kconfig
menu "Virtual Keyboard"

    config VKEY_WIFI_SSID
        string "WiFi SSID (station mode)"
        default ""
        help
            SSID of the router the device joins in station mode. Empty means
            the device boots straight into soft-AP pairing mode.

    config VKEY_WIFI_PASSWORD
        string "WiFi password"
        default ""
        help
            Passphrase for the router. Empty is accepted for open networks.

    config VKEY_AP_FALLBACK_TIMEOUT_MS
        int "Station connect timeout before falling back to soft-AP"
        default 15000
        help
            Milliseconds to wait for an IP before switching to soft-AP mode
            (SSID: VKEY-XXXX) so the phone can still pair without a router.

    config VKEY_MAX_TEXT_LEN
        int "Maximum text length relayed from phone to display"
        default 4000

    config VKEY_TOUCH_X_MIN
        int "Touch raw X minimum"
        default 4
        range 0 4095

    config VKEY_TOUCH_X_MAX
        int "Touch raw X maximum"
        default 307
        range 1 4095

    config VKEY_TOUCH_Y_MIN
        int "Touch raw Y minimum"
        default 4
        range 0 4095

    config VKEY_TOUCH_Y_MAX
        int "Touch raw Y maximum"
        default 475
        range 1 4095
endmenu
```

## sdkconfig.defaults
```kconfig
CONFIG_IDF_TARGET="esp32s3"
CONFIG_ESPTOOLPY_FLASHMODE_QIO=y
CONFIG_ESPTOOLPY_FLASHSIZE_8MB=y
CONFIG_PARTITION_TABLE_CUSTOM=y
CONFIG_PARTITION_TABLE_CUSTOM_FILENAME="partitions.csv"
CONFIG_QMSD_BOARD_CUSTOM=y
CONFIG_COMPILER_OPTIMIZATION_PERF=y
CONFIG_SPIRAM=y
CONFIG_SPIRAM_MODE_OCT=y
CONFIG_SPIRAM_SPEED_80M=y
CONFIG_ESP_DEFAULT_CPU_FREQ_MHZ_240=y
CONFIG_FREERTOS_HZ=1000
CONFIG_QMSD_BOARD_BACKLIGHT_VALUE=100
CONFIG_QMSD_BOARD_TOUCH_EN=y
CONFIG_QMSD_TOUCH_I2C_FREQ=400000
CONFIG_QMSD_BOARD_GUI_EN=y
CONFIG_QMSD_GUI_DOUBLE_BUFFER=y
CONFIG_QMSD_GUI_BUFFER_IN_PSRAM=y
CONFIG_QMSD_GUI_LVGL_V8=y
CONFIG_LV_CONF_SKIP=y
CONFIG_LV_COLOR_DEPTH_16=y
CONFIG_LV_COLOR_DEPTH=16
CONFIG_LV_MEM_CUSTOM=y
CONFIG_LV_MEM_CUSTOM_INCLUDE="stdlib.h"
CONFIG_LV_FONT_MONTSERRAT_14=y
CONFIG_LV_FONT_MONTSERRAT_24=y
CONFIG_LV_FONT_MONTSERRAT_36=y
CONFIG_LV_USE_QRCODE=y
CONFIG_LV_DPI_DEF=130
CONFIG_HTTPD_WS_SUPPORT=y
# Touch calibration (same physical panel as esp-resto, portrait 320x480)
CONFIG_VKEY_TOUCH_X_MIN=4
CONFIG_VKEY_TOUCH_X_MAX=307
CONFIG_VKEY_TOUCH_Y_MIN=4
CONFIG_VKEY_TOUCH_Y_MAX=475
# WiFi credentials for station mode. Empty password support not needed; set your router SSID/pass.
CONFIG_VKEY_WIFI_SSID=""
CONFIG_VKEY_WIFI_PASSWORD=""
CONFIG_VKEY_AP_FALLBACK_TIMEOUT_MS=15000
```
